## drivers/hwmon/Kconfig.rej
```kconfig
--- drivers/hwmon/Kconfig
+++ drivers/hwmon/Kconfig
@@ -402,12 +402,12 @@
 	  will be called gl520sm.
 
 config SENSORS_CORETEMP
-	tristate "Intel Core (2) Duo/Solo temperature sensor"
+	tristate "Intel Core/Core2/Atom temperature sensor"
 	depends on X86 && EXPERIMENTAL
 	help
 	  If you say yes here you get support for the temperature
-	  sensor inside your CPU. Supported all are all known variants
-	  of Intel Core family.
+	  sensor inside your CPU. Most of the family 6 CPUs
+	  are supported. Check documentation/driver for details.
 
 config SENSORS_IBMAEM
 	tristate "IBM Active Energy Manager temperature/power sensors and control"
```

## hcc/Kconfig.HCC
```kconfig
menu "Cluster support"

config HCC
	bool "Add the HCC support"
	depends on PREEMPT_NONE && !KEYS && !COMPAT
	default y
	select HCC_TOOLS if !HCC_DEVEL
	select HCC_COMMUNICATION_FRAMEWORK if !HCC_DEVEL
	select HCC_HOTPLUG if !HCC_DEVEL
	select HCC_KDDM if !HCC_DEVEL
	select HCC_CAP if !HCC_DEVEL
	select HCC_PROCFS if !HCC_DEVEL
	select HCC_MM if !HCC_DEVEL
	select HCC_DVFS if !HCC_DEVEL
	select HCC_FAF if !HCC_DEVEL
	select HCC_IPC if !HCC_DEVEL
	select HCC_PROC if !HCC_DEVEL
	select HCC_EPM if !HCC_DEVEL
	select HCC_SCHED if !HCC_DEVEL
	help
	  Say Y if you want to use the HCC features.	

comment "HCC requires kernel preemption to be fully disabled (PREEMPT_NONE)"
	depends on !PREEMPT_NONE

comment "HCC does not support access key retention (KEYS)"
	depends on KEYS

comment "HCC does not support 32 bits emulation (COMPAT)"
	depends on COMPAT

config HCC_DEVEL
	bool "Allow to build a subset of HCC (!! HCC development only !!)"
	depends on HCC
	default n
	help
	  The only reason to enable this, is that you intend to port HCC
		on a new architecture.

		Just say N, and forget about it.

config HCC_TOOLS
	bool "Tools"
	depends on HCC
	help
	  Common library in HCC (without communication)

config HCC_COMMUNICATION_FRAMEWORK
       bool "Communication layer"
       depends on HCC
       select TIPC
       select HCC_GRPC
       help
         All-purpose communication layer

config HCC_AUTONODEID
	bool "Allow node id to bet set automatically"
	depends on HCC_COMMUNICATION_FRAMEWORK
	default y
	help
	  Compile support to let the kernel automatically set the node id.
	  The method to compute the node id can be chosen with kernel boot
	  parameter "autonodeid", which default value can be changed with
	  the choice menu below. Available methods are described in that
	  menu.

	  Enabling this option will use 8 bits instead of 7 bits for node ids,
	  which doubles the size of various node id masks, especially used in
	  KDDM metadata.

	  If unsure, say Y.

choice
	prompt "Default value of boot parameter autonodeid"
	default HCC_AUTONODEID_ON
	depends on HCC_AUTONODEID

config HCC_AUTONODEID_ON
	bool "IP address (autonodeid=1)"
	help
	  During the boot the kernel must be able to get an IP address
	  (dhcp, command line, etc.), and will set the node id to the least
	  significant byte of the IP address.

	  In order to avoid any headache, be sure that all your nodes are
	  on the same /24 network.

	  This value can be overridden by kernel boot parameter autonodeid.

	  If unsure, say Y.

config HCC_AUTONODEID_OFF
	bool "off (autonodeid=0)"
	help
	  The kernel will not attempt to automatically set the node id. A valid
	  node id must be provided with kernel boot parameter "node_id".

	  This value can be overridden by kernel boot parameter "autonodeid".

	  If unsure, say N.

endchoice

config HCC_HOTPLUG
	bool "KerHotplug"
	depends on HCC
	help
	  Support for nodes management

config HCC_HOTPLUG_DEL
	bool "KerHotplug: removal support"
	depends on HCC_HOTPLUG
	help
	  Support node removal

config HCC_HOTPLUG_XCH
	bool "KerHotplug: replacement support"
	depends on HCC_HOTPLUG
	help
	  Support node replacement

config HCC_DISABLE_HEARTBEAT
       bool "Disable failure detector"
       depends on HCC_HOTPLUG
       help
         If you don't want automatic reconfiguration on a node failure
         just select this option.

config HCC_KDDM
	bool "Kernel Distributed Data Management (KDDM)"
	depends on HCC_COMMUNICATION_FRAMEWORK
	help
	  Cluster wide data management. This is the general purpose
	  mechanism used in HCC to implement distributed
	  services.

	  If unsure, say Y.

config HCC_KDDM_DEBUG
	def_bool HCC_KDDM && HCC_DEBUG

config HCC_CAP
	bool "KerCapabilities"
	depends on HCC
	help
	  HCC capabilities mechanism.

	  If unsure, say Y.

config HCC_PROCFS
	bool "ProcFS"
	depends on HCC_KDDM && HCC
	help
	  Global /proc mechanism.

	  If unsure, say Y.

#config HCC_SYNC
#	bool "KerSync"
#	depends on HCC && HCC_KDDM
#	help
#	  Synchronization library

config HCC_MM
	bool "KerMM"
	depends on HCC && HCC_KDDM && !TRACK_DIRTY_PAGES && !COMPACTION && !KSM  && !TRANSPARENT_HUGEPAGE
	help
	  HCC's global memory management

config HCC_DVFS
	bool "Distributed VFS"
#	depends on HCC_MM && HCC
	depends on HCC
	help
	  HCC's distributed VFS. This is the HCC basic
	  bloc for distributed file management.

	  If unsure, say Y.

config HCC_FAF
	bool "File access forwarding"
	depends on HCC && HCC_DVFS
	select EPOLL
	help
	  Enable migration of open files and streams for those which
	  cannot be more efficiently managed by other HCC mechanisms.

	  If unsure, say Y.

config HCC_IPC
	bool "KerIPC"
	depends on HCC && HCC_KDDM && HCC_MM && IPC_NS
	help
	  HCC's global IPC management

config HCC_PROC
	bool "KerProc"
	depends on HCC && HCC_KDDM
	help
	  Low-level global process management: global PIDs, syscalls affecting
	  remote tasks (including signals), global proc PID entries.

	  If unsure, say Y.

config HCC_EPM
	bool "KerEPM"
	depends on HCC && HCC_PROC && HCC_CAP && HCC_MM && (HCC_DVFS || HCC_FAF)
	help
	  Enhanced Process Management:
	    process migration, checkpoint/restart, remote clone.

	  If unsure, say Y.

config HCC_IPC_EPM
       def_bool HCC_IPC && HCC_EPM

menuconfig HCC_SCHED
	bool "HCC support for global scheduling"
	depends on HCC
	select CONFIGFS_FS
	default y
	help
	  Compile support for global schedulers.

	  This framework allows, at run-time, to build and configure schedulers
	  from third parties hot-pluggable components.

	  If you want automagic loading of scheduler modules while configuring
	  a scheduler, you must select "Automatic module loading" (KMOD) in
	  section "Loadable module support".

	  If unsure, say Y.

if HCC_SCHED

config HCC_SCHED_COMPAT
	bool "Compile components needed to emulate HCC 2.3 hard-coded scheduler"
	depends on HCC_SCHED && HCC_EPM
	default y
	help
	  This option selects the components needed to obtain the same
	  scheduling policy as in HCC 2.3 hard-coded scheduler.
	  See the sample script hcc_legacy_scheduler located in HCC's
	  tools to setup this compatible scheduler.

	  If unsure, say Y.

config HCC_SCHED_COMPAT_FORCE
	def_tristate m if HCC_SCHED_COMPAT
	select HCC_SCHED_MIGRATION_PROBE
	select HCC_SCHED_MOSIX_PROBE
	select HCC_SCHED_THRESHOLD_FILTER
	select HCC_SCHED_FREQ_LIMIT_FILTER
	select HCC_SCHED_REMOTE_CACHE_FILTER
	select HCC_SCHED_MOSIX_LOAD_BALANCER
	select HCC_SCHED_ROUND_ROBIN_BALANCER

config HCC_SCHED_CPU_PROBE
	tristate "Sample CPU probe"
	depends on m
	default n
	help
	  Sample CPU probe exposing the CPU load of a node

	  If unsure, say N.

config HCC_SCHED_MEM_PROBE
	tristate "Sample memory probe"
	depends on m
	default n
	help
	  Sample memory probe exposing the total RAM and free RAM available on
	  a node

	  If unsure, say N.

config HCC_SCHED_MIGRATION_PROBE
	tristate "Migration probe"
	depends on HCC_EPM && m
	default n
	help
	  Probe counting the number of ongoing task migrations out of a node
	  and registering the last migration event.

	  If unsure, say N.

config HCC_SCHED_MOSIX_PROBE
	tristate "MOSIX-like CPU probe"
	depends on m
	default n
	help
	  MOSIX-like CPU probe exposing the CPU load of a node as well as the
	  CPU load induced by individual tasks

	  If unsure, say N.

config HCC_SCHED_THRESHOLD_FILTER
	tristate "Threshold filter"
	depends on m
	default n
	help
	  Filter propagating events only if the value exceeds the configured
	  threshold

	  If unsure, say N.

config HCC_SCHED_FREQ_LIMIT_FILTER
	tristate "Frequency limit filter"
	depends on m
	default n
	help
	  Filter propagating events only if, for a configured action monitored,
	  no action is ongoing and the last one occured more than a configured
	  delay before

	  If unsure, say N.

config HCC_SCHED_REMOTE_CACHE_FILTER
	tristate "Remote cache filter"
	depends on m
	default n
	help
	  Filter caching values from the other nodes, at a configured refresh
	  rate

	  If unsure, say N.

config HCC_SCHED_ECHO_POLICY
	tristate "Sample echo policy"
	depends on m
	default n
	help
	  Sample policy that logs the values read on its ports when update
	  notifications are received

	  If unsure, say N.

config HCC_SCHED_MOSIX_LOAD_BALANCER
	tristate "MOSIX-like load balancing policy"
	depends on HCC_EPM && m
	default n
	help
	  Migration-based load balancing policy using simplified algorithms
	  from the CPU load balancing policy found in MOSIX

	  If unsure, say N.

config HCC_SCHED_ROUND_ROBIN_BALANCER
	tristate "Round robin balancing policy"
	depends on m
	default n
	help
	  Policy that selects target nodes in a round robin manner when called

	  If unsure, say N.

endif

config CLUSTER_WIDE_PROC_INFRA
	bool

config CLUSTER_WIDE_PROC
	bool "See Cluster wide stats in /proc"
	depends on HCC
	default y
	select CLUSTER_WIDE_PROC_INFRA
	help
	  Say yes if you want to see your cluster as a big SMP through the
	  /proc files (meminfo, cpuinfo, etc).
	  
	  If unsure, say Y.

config CLUSTER_WIDE_PROC_CPUINFO
	bool
	depends on HCC
	default CLUSTER_WIDE_PROC || HCC_PROC
	select CLUSTER_WIDE_PROC_INFRA

config CLUSTER_WIDE_PROC_MEMINFO
	bool
	depends on HCC
	default CLUSTER_WIDE_PROC || HCC_MM
	select CLUSTER_WIDE_PROC_INFRA

config CLUSTER_WIDE_PROC_LOADAVG
	bool
	depends on HCC
	default CLUSTER_WIDE_PROC || HCC_PROC
	select CLUSTER_WIDE_PROC_INFRA

config CLUSTER_WIDE_PROC_STAT
	bool
	depends on HCC
	default CLUSTER_WIDE_PROC || HCC_PROC
	select CLUSTER_WIDE_PROC_INFRA

config CLUSTER_WIDE_PROC_UPTIME
	bool
	depends on HCC
	default CLUSTER_WIDE_PROC || HCC_PROC
	select CLUSTER_WIDE_PROC_INFRA

config HCC_SYSCALL_EXIT_HOOK
        bool "Syscall exit hook"
	depends on HCC
	default n

config DEBUG_SEG_FAULT
	bool "Debug seg faults"
	depends on HCC
	default n

config HCC_DEBUG
	bool "Debug subsystem"
	depends on HCC
	default n
	select DEBUG_FS
	help
	  Activate HCC's debug subsystem. With this
          subsystem, most HCC debugs can be activated
          dynamically at runtime, after having mounted debugfs. To
          activate debugs for the other subsystems, you will also
          have to activate them in their respective source
          directories.

          This option will increase code size and probably slow
          down the system.

          If unsure, say N.

endmenu
```

## net/gipc/Kconfig
```kconfig
#
# GIPC configuration
#

menuconfig GIPC
	tristate "The GIPC Protocol (EXPERIMENTAL)"
	depends on INET && EXPERIMENTAL
	---help---
	  The Transparent Inter Process Communication (GIPC) protocol is
	  specially designed for intra cluster communication. This protocol
	  originates from Ericsson where it has been used in carrier grade
	  cluster applications for many years.
	
	  For more information about GIPC, see http://gipc.sourceforge.net.

	  This protocol support is also available as a module ( = code which
	  can be inserted in and removed from the running kernel whenever you
	  want). The module will be called gipc. If you want to compile it
	  as a module, say M here and read <file:Documentation/kbuild/modules.txt>.

	  If in doubt, say N.

if GIPC

config GIPC_ADVANCED
	bool "GIPC: Advanced configuration"
	depends on GIPC
	default n
	help
	  Saying Y here will open some advanced configuration
          for GIPC. Most users do not need to bother, so if
          unsure, just say N.

config GIPC_ZONES
	int "Maximum number of zones in network"
	depends on GIPC_ADVANCED
	default "3"
	help
	 Max number of zones inside GIPC network. Max supported value 
         is 255 zones, minimum is 1

	 Default is 3 zones in a network; setting this to higher
	 allows more zones but might use more memory.

config GIPC_CLUSTERS
	int "Maximum number of clusters in a zone"
	depends on GIPC_ADVANCED
	default "1"
	help
          ***Only 1 (one cluster in a zone) is supported by current code.
          Any value set here will be overridden.***

          (Max number of clusters inside GIPC zone. Max supported 
          value is 4095 clusters, minimum is 1.

	  Default is 1; setting this to smaller value might save 
          some memory, setting it to higher
	  allows more clusters and might consume more memory.)

config GIPC_NODES
	int "Maximum number of nodes in cluster"
	depends on GIPC_ADVANCED
	default "255"
	help
	  Maximum number of nodes inside a GIPC cluster. Maximum 
          supported value is 2047 nodes, minimum is 8. 

	  Setting this to a smaller value saves some memory, 
	  setting it to higher allows more nodes.

config GIPC_SLAVE_NODES
	int "Maximum number of slave nodes in cluster"
	depends on GIPC_ADVANCED
	default "0"
	help
          ***This capability is not supported by current code.***
	  
	  Maximum number of slave nodes inside a GIPC cluster. Maximum 
          supported value is 2047 nodes, minimum is 0. 

	  Setting this to a smaller value saves some memory, 
	  setting it to higher allows more nodes.

config GIPC_PORTS
	int "Maximum number of ports in a node"
	depends on GIPC_ADVANCED
	default "8191"
	help
	  Maximum number of ports within a node. Maximum 
          supported value is 64535 nodes, minimum is 127. 

	  Setting this to a smaller value saves some memory, 
	  setting it to higher allows more ports.

config GIPC_LOG
	int "Size of log buffer"
	depends on GIPC_ADVANCED
	default 0
	help
 	  Size (in bytes) of GIPC's internal log buffer, which records the
	  occurrence of significant events.  Maximum supported value
	  is 32768 bytes, minimum is 0.

	  There is no need to enable the log buffer unless the node will be
	  managed remotely via GIPC.

config GIPC_DEBUG
	bool "Enable debugging support"
	depends on GIPC
	default n
	help
 	  This will enable debugging of GIPC.

	  Only say Y here if you are having trouble with GIPC.  It will
	  enable the display of detailed information about what is going on.

endif # GIPC
```

## net/grpc/Kconfig
```kconfig
#
# HCC RPC Configuration
#

config GRPC
	bool "HCC RPC Protocol"
	depends on GIPC
	---help---
	  Cluster-aware Remote Procedure Call (RPC) framework.

	  This protocol is dedicated to distributed operating system services.
	  User-space application are not supposed to use this protocol.

	  For more informations about KRPC, see http://www.hcc.org

	  Currently, if you are not planning to run HCC, say N.
```
